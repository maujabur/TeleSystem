## components/tele_wifi/Kconfig
```kconfig
menu "WiFi Config"

config ESP_WIFI_SSID
    string "WiFi SSID"
    default "Mau"

config ESP_WIFI_PASSWORD
    string "WiFi Password"
    default "123456789d"

config WIFI_PROVISIONING_SSID
    string "Wi-Fi provisioning AP SSID"
    default "ESP32-Device"

config WIFI_MODEM_SLEEP
    bool "Enable Wi-Fi modem sleep in station mode"
    default y
    help
        Habilita WIFI_PS_MIN_MODEM quando o dispositivo estiver conectado
        apenas como station. O AP de provisionamento continua com power save
        desativado para manter o portal responsivo.

config WIFI_MULTI_NETWORK_CREDENTIALS
    bool "Enable multi-network credentials storage (experimental)"
    default n
    help
        Habilita armazenamento de ate 8 redes com prioridade quando ativado.
        Quando desativado, usa o formato simples atual com uma rede.

config WIFI_STA_MAX_RETRY
    int "Max STA reconnect retries before provisioning fallback"
    range 1 20
    default 3
    help
        Numero maximo de tentativas de reconexao STA antes de entrar
        automaticamente no AP de provisionamento.

config WIFI_APSTA_POLICY
    int "APSTA policy after STA connect"
    range 0 2
    default 1
    help
        0 = always_on (mantem APSTA),
        1 = auto_timeout (mantem APSTA por janela e depois muda para STA),
        2 = sta_only (desativa AP imediatamente apos conectar STA).

config WIFI_APSTA_GRACE_PERIOD_S
    int "APSTA auto-timeout grace period (seconds)"
    range 30 3600
    default 600
    help
        Janela de permanencia em APSTA quando a politica estiver em
        auto_timeout.

config BOOT_WIFI_CONFIG_BUTTON_GPIO
    int "Boot Wi-Fi configuration button GPIO"
    range 0 48
    default 3

config BOOT_WIFI_CONFIG_BUTTON_ACTIVE_LEVEL
    int "Boot Wi-Fi configuration button active level"
    range 0 1
    default 1
    help
        Use 0 para botao ativo em nivel baixo, normalmente ligado ao GND
        com pull-up interno. Use 1 para botao ativo em nivel alto.

config BOOT_WIFI_CONFIG_BUTTON_SETTLE_MS
    int "Boot Wi-Fi configuration button settle time (ms)"
    range 0 1000
    default 20

config BOOT_WIFI_CONFIG_BUTTON_SAMPLE_COUNT
    int "Boot Wi-Fi configuration button sample count"
    range 1 20
    default 5

config BOOT_WIFI_CONFIG_BUTTON_SAMPLE_INTERVAL_MS
    int "Boot Wi-Fi configuration button sample interval (ms)"
    range 0 1000
    default 10

endmenu

menu "Time Sync Config"

config TIME_SYNC_ENABLED
    bool "Enable NTP time synchronization"
    default y
    help
        Habilita sincronizacao de data/hora via NTP apos conexao de rede.

config TIME_SYNC_TIMEZONE
    string "Default timezone (POSIX TZ string)"
    depends on TIME_SYNC_ENABLED
    default "<-03>3"
    help
        Fuso horario padrao usado para formatar horario local.
        O valor padrao corresponde a Sao Paulo (UTC-3, sem horario de verao).

config TIME_SYNC_MIN_VALID_YEAR
    int "Minimum valid synchronized year"
    depends on TIME_SYNC_ENABLED
    range 2024 2100
    default 2024
    help
        Ano minimo aceito para considerar o relogio sincronizado.

config TIME_SYNC_RETRY_ATTEMPTS
    int "NTP attempts per sync cycle"
    depends on TIME_SYNC_ENABLED
    range 1 10
    default 3

config TIME_SYNC_WAIT_PER_ATTEMPT_MS
    int "Wait per NTP attempt (ms)"
    depends on TIME_SYNC_ENABLED
    range 1000 60000
    default 5000

config TIME_SYNC_RETRY_DELAY_MS
    int "Delay before next sync cycle (ms)"
    depends on TIME_SYNC_ENABLED
    range 1000 86400000
    default 60000

config TIME_SYNC_IDLE_DELAY_MS
    int "Idle delay when already synchronized/offline (ms)"
    depends on TIME_SYNC_ENABLED
    range 1000 60000
    default 10000

config TIME_SYNC_SERVER_0
    string "Primary NTP server"
    depends on TIME_SYNC_ENABLED
    default "pool.ntp.org"

config TIME_SYNC_SERVER_1
    string "Secondary NTP server"
    depends on TIME_SYNC_ENABLED
    default "time.google.com"

config TIME_SYNC_SERVER_2
    string "Tertiary NTP server"
    depends on TIME_SYNC_ENABLED
    default "time.cloudflare.com"

endmenu
```

## examples/component_consumer_mqtt/main/Kconfig.projbuild
```kconfig
menu "TeleSystem Consumer MQTT Example"

config EXAMPLE_MQTT_ENABLED
    bool "Start MQTT client"
    default n

config EXAMPLE_MQTT_BROKER_URI
    string "MQTT broker URI"
    depends on EXAMPLE_MQTT_ENABLED
    default ""

config EXAMPLE_MQTT_USERNAME
    string "MQTT username"
    depends on EXAMPLE_MQTT_ENABLED
    default ""

config EXAMPLE_MQTT_PASSWORD
    string "MQTT password"
    depends on EXAMPLE_MQTT_ENABLED
    default ""

config EXAMPLE_MQTT_BASE_TOPIC
    string "MQTT base topic"
    depends on EXAMPLE_MQTT_ENABLED
    default "v1/example"

config EXAMPLE_MQTT_DEVICE_ID_PREFIX
    string "MQTT device ID prefix"
    depends on EXAMPLE_MQTT_ENABLED
    default "ExampleDevice"

endmenu
```

## examples/full_project_consumer/sdkconfig.defaults
```kconfig
CONFIG_IDF_TARGET="esp32s3"
CONFIG_IDF_TARGET_ESP32S3=y
CONFIG_ESPTOOLPY_FLASHSIZE_8MB=y
CONFIG_PARTITION_TABLE_CUSTOM=y
CONFIG_PARTITION_TABLE_CUSTOM_FILENAME="partitions.csv"
CONFIG_ESP_CONSOLE_USB_SERIAL_JTAG=y
CONFIG_ESP_CONSOLE_USB_SERIAL_JTAG_ENABLED=y
# CONFIG_ESP_CONSOLE_UART_DEFAULT is not set
CONFIG_ESP_CONSOLE_SECONDARY_NONE=y

# Defaults seguros para o exemplo: compila o app completo sem depender de broker,
# credenciais reais, GPIO de LED ou shutdown de bateria.
# CONFIG_STATUS_LED_ENABLED is not set
# CONFIG_MQTT_PRESENCE_ENABLED is not set
# CONFIG_VBAT_MONITOR_ENABLED is not set
# CONFIG_VBAT_SHUTDOWN_ENABLED is not set
# CONFIG_POWER_GOOD_GPIO_ENABLED is not set
# CONFIG_TELE_CA_UPDATER_BOOT_ENABLED is not set

CONFIG_SPIRAM=y
CONFIG_SPIRAM_MODE_OCT=y
CONFIG_SPIRAM_TYPE_AUTO=y
CONFIG_SPIRAM_SPEED_40M=y
CONFIG_SPIRAM_BOOT_INIT=y
CONFIG_SPIRAM_USE_MALLOC=y
CONFIG_SPIRAM_MALLOC_ALWAYSINTERNAL=16384
CONFIG_SPIRAM_MALLOC_RESERVE_INTERNAL=32768
CONFIG_SPIRAM_TRY_ALLOCATE_WIFI_LWIP=y
CONFIG_NVS_ALLOCATE_CACHE_IN_SPIRAM=y

CONFIG_WIFI_PROVISIONING_SSID="TeleSystem"
CONFIG_WIFI_MODEM_SLEEP=y
CONFIG_WIFI_MULTI_NETWORK_CREDENTIALS=y
CONFIG_WIFI_STA_MAX_RETRY=3
CONFIG_WIFI_APSTA_POLICY=1
CONFIG_WIFI_APSTA_GRACE_PERIOD_S=600

CONFIG_BOOT_WIFI_CONFIG_BUTTON_GPIO=3
CONFIG_BOOT_WIFI_CONFIG_BUTTON_ACTIVE_LEVEL=1
CONFIG_BOOT_WIFI_CONFIG_BUTTON_SETTLE_MS=20
CONFIG_BOOT_WIFI_CONFIG_BUTTON_SAMPLE_COUNT=5
CONFIG_BOOT_WIFI_CONFIG_BUTTON_SAMPLE_INTERVAL_MS=10

CONFIG_TIME_SYNC_ENABLED=y
CONFIG_TIME_SYNC_TIMEZONE="<-03>3"
CONFIG_TIME_SYNC_MIN_VALID_YEAR=2024
CONFIG_TIME_SYNC_RETRY_ATTEMPTS=3
CONFIG_TIME_SYNC_WAIT_PER_ATTEMPT_MS=5000
CONFIG_TIME_SYNC_RETRY_DELAY_MS=60000
CONFIG_TIME_SYNC_IDLE_DELAY_MS=10000
CONFIG_TIME_SYNC_SERVER_0="pool.ntp.org"
CONFIG_TIME_SYNC_SERVER_1="time.google.com"
CONFIG_TIME_SYNC_SERVER_2="time.cloudflare.com"

CONFIG_TELE_PORTAL_LOGS_ENABLE_ENDPOINT=y
CONFIG_WEB_PORTAL_EXPOSE_NETWORK_IDENTIFIERS=y
CONFIG_WEB_PORTAL_DETAILED_HTTP_ERRORS=y

CONFIG_ESP_MAIN_TASK_STACK_SIZE=6144
CONFIG_ESP_SYSTEM_EVENT_TASK_STACK_SIZE=4096
```

## main/Kconfig.projbuild
```kconfig
menu "Web Portal Config"

config WEB_PORTAL_ENABLE_LOGS_ENDPOINT
    bool "Enable /api/logs endpoint"
    default y
    help
        Mantem a API de logs disponivel no portal tecnico. Recomendado
        desativado para builds de release.

config WEB_PORTAL_EXPOSE_NETWORK_IDENTIFIERS
    bool "Expose SSID/IP identifiers in technical APIs"
    default n
    help
        Quando desativado, /api/status e APIs tecnicas relacionadas evitam
        expor SSID/IP/provisioning_ssid diretamente.

config WEB_PORTAL_DETAILED_HTTP_ERRORS
    bool "Return detailed internal errors in HTTP responses"
    default n
    help
        Quando desativado, endpoints tecnicos retornam mensagens genericas
        para falhas internas, reduzindo exposicao de detalhes internos.

config APP_LOG_BUFFER_CAPTURE_DEBUG
    bool "Capture DEBUG/VERBOSE logs in /api/logs buffer"
    default n
    help
        Quando desativado, o buffer usado por /api/logs ignora linhas de
        DEBUG/VERBOSE para reduzir ruido e volume.

endmenu

menu "MQTT Presence Config"

config MQTT_PRESENCE_ENABLED
    bool "Enable MQTT presence and heartbeat"
    default n
    help
        Habilita publicacao de presenca online/offline, heartbeat e canal
        basico de comando MQTT para operacao remota.

config MQTT_BROKER_URI
    string "MQTT broker URI"
    depends on MQTT_PRESENCE_ENABLED
    default ""
    help
        URI do broker MQTT, por exemplo: mqtts://broker.exemplo.com:8883

config MQTT_USERNAME
    string "MQTT username"
    depends on MQTT_PRESENCE_ENABLED
    default ""

config MQTT_PASSWORD
    string "MQTT password"
    depends on MQTT_PRESENCE_ENABLED
    default ""

config MQTT_TOPIC_NAMESPACE
    string "MQTT topic namespace"
    depends on MQTT_PRESENCE_ENABLED
    default "v1/led"
    help
        Prefixo de topicos usado pelo dispositivo. O device_id sera
        anexado automaticamente.

config MQTT_DEVICE_ID_PREFIX
    string "MQTT device ID prefix"
    depends on MQTT_PRESENCE_ENABLED
    default "TeleCafezinho"
    help
        Prefixo usado para montar o device_id publicado em MQTT.

config MQTT_HEARTBEAT_INTERVAL_S
    int "Heartbeat interval (seconds)"
    depends on MQTT_PRESENCE_ENABLED
    range 15 3600
    default 60

config MQTT_KEEPALIVE_S
    int "MQTT keepalive (seconds)"
    depends on MQTT_PRESENCE_ENABLED
    range 15 1200
    default 60

config MQTT_QOS_CRITICAL
    int "QoS for status/state/command"
    depends on MQTT_PRESENCE_ENABLED
    range 0 2
    default 1

config MQTT_QOS_TELEMETRY
    int "QoS for heartbeat/telemetry"
    depends on MQTT_PRESENCE_ENABLED
    range 0 2
    default 0

endmenu

menu "VBAT Monitor Config"

config VBAT_MONITOR_ENABLED
    bool "Enable VBAT monitor"
    default n
    help
        Habilita monitoramento de tensao da bateria por ADC com calibracao.

config VBAT_MONITOR_GPIO
    int "VBAT ADC GPIO"
    depends on VBAT_MONITOR_ENABLED
    range 0 48
    default 1
    help
        GPIO conectada ao divisor resistivo da bateria.

config VBAT_MONITOR_MAX_INTERVAL_S
    int "Max interval without VBAT measurement (seconds)"
    depends on VBAT_MONITOR_ENABLED
    range 0 86400
    default 120
    help
        Tempo maximo sem tentativa de medicao. Use 0 para desabilitar.

config VBAT_MONITOR_ON_BOOT
    bool "Measure at startup"
    depends on VBAT_MONITOR_ENABLED
    default y

config VBAT_MONITOR_ON_BEFORE_WIFI_PS_EXIT
    bool "Measure before leaving Wi-Fi power save"
    depends on VBAT_MONITOR_ENABLED
    default y

config VBAT_MONITOR_ON_AFTER_PRODUCT_TX
    bool "Measure after product transmission"
    depends on VBAT_MONITOR_ENABLED
    default y

config VBAT_MONITOR_ON_AFTER_PRODUCT_ACTIVITY
    bool "Measure after product activity"
    depends on VBAT_MONITOR_ENABLED
    default y

config VBAT_MONITOR_ON_MAX_INTERVAL
    bool "Measure when max interval elapses"
    depends on VBAT_MONITOR_ENABLED
    default y

config VBAT_SHUTDOWN_ENABLED
    bool "Enable low-battery shutdown"
    depends on VBAT_MONITOR_ENABLED
    default y
    help
        Quando habilitado, o sistema desliga os perifericos via POWER_GOOD
        e entra em deep sleep (sem wakeup por timer) ao detectar tensao
        critica por tempo suficiente.

config VBAT_SHUTDOWN_THRESHOLD_MV
    int "Low-battery shutdown threshold (mV)"
    depends on VBAT_SHUTDOWN_ENABLED
    range 2500 4200
    default 3500
    help
        Tensao da bateria abaixo da qual o desligamento e iniciado.
        Recomendado: 3500 mV para Li-Ion/LiPo de celula unica.

config VBAT_SHUTDOWN_DEBOUNCE_MS
    int "Low-battery shutdown debounce time (ms)"
    depends on VBAT_SHUTDOWN_ENABLED
    range 100 10000
    default 1000
    help
        Tempo minimo continuo com tensao abaixo do limiar para confirmar
        desligamento. Evita falsos positivos por quedas de tensao sob carga.

config VBAT_MAINTENANCE_MODE_MAX_MV
    int "Maintenance mode detection threshold (mV)"
    depends on VBAT_SHUTDOWN_ENABLED
    range 0 2000
    default 500
    help
        Se a tensao lida for menor ou igual a este valor, o sistema assume
        modo de manutencao (bateria desconectada) e inibe o desligamento
        automatico por bateria baixa.

config VBAT_MONITOR_RDIV_RVCC
    int "Voltage divider resistor Rvcc (ohms)"
    depends on VBAT_MONITOR_ENABLED
    range 1 1000000
    default 4640
    help
        Resistor entre VCC da bateria e o pino ADC no divisor de tensao.

config VBAT_MONITOR_RDIV_RGND
    int "Voltage divider resistor Rgnd (ohms)"
    depends on VBAT_MONITOR_ENABLED
    range 1 1000000
    default 5620
    help
        Resistor entre o pino ADC e GND no divisor de tensao.

endmenu

menu "POWER_GOOD GPIO Config"

config POWER_GOOD_GPIO_ENABLED
    bool "Enable POWER_GOOD output GPIO"
    default y
    help
        Habilita o sinal POWER_GOOD: GPIO de saida que alimenta perifericos
        externos via MOSFET. Seta alto ao inicializar
        e baixo antes de entrar em deep sleep.

config POWER_GOOD_GPIO
    int "POWER_GOOD GPIO number"
    depends on POWER_GOOD_GPIO_ENABLED
    range 0 48
    default 6
    help
        Numero da GPIO usada como sinal POWER_GOOD.

config POWER_GOOD_ACTIVE_LEVEL
    int "POWER_GOOD active level (1=high, 0=low)"
    depends on POWER_GOOD_GPIO_ENABLED
    range 0 1
    default 1
    help
        Nivel logico que representa "perifericos ligados".
        Use 1 para MOSFET ativo em nivel alto.

endmenu
```
