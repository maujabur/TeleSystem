## sdkconfig.defaults
```kconfig
CONFIG_ESPTOOLPY_FLASHSIZE_8MB=y
CONFIG_ESPTOOLPY_BEFORE_RESET=y
# CONFIG_ESPTOOLPY_BEFORE_NORESET is not set
CONFIG_ESPTOOLPY_BEFORE="default-reset"
# CONFIG_ESPTOOLPY_AFTER_RESET is not set
CONFIG_ESPTOOLPY_AFTER_NORESET=y
CONFIG_ESPTOOLPY_AFTER="no-reset"
CONFIG_PARTITION_TABLE_CUSTOM=y
CONFIG_PARTITION_TABLE_CUSTOM_FILENAME="partitions.csv"
CONFIG_ESP_CONSOLE_USB_SERIAL_JTAG=y
CONFIG_ESP_CONSOLE_USB_SERIAL_JTAG_ENABLED=y
# CONFIG_ESP_CONSOLE_UART_DEFAULT is not set
# CONFIG_ESP_CONSOLE_SECONDARY_USB_SERIAL_JTAG is not set
CONFIG_ESP_CONSOLE_SECONDARY_NONE=y
# CONFIG_STATUS_LED_ENABLED is not set
CONFIG_SPIRAM=y
CONFIG_SPIRAM_MODE_OCT=y
CONFIG_SPIRAM_TYPE_AUTO=y
CONFIG_SPIRAM_SPEED_40M=y
CONFIG_SPIRAM_BOOT_INIT=y
CONFIG_SPIRAM_USE_MALLOC=y
CONFIG_SPIRAM_MALLOC_ALWAYSINTERNAL=16384
CONFIG_SPIRAM_MALLOC_RESERVE_INTERNAL=32768
CONFIG_SPIRAM_TRY_ALLOCATE_WIFI_LWIP=y
CONFIG_NVS_ALLOCATE_CACHE_IN_SPIRAM=y
CONFIG_ESP_WIFI_STATIC_RX_BUFFER_NUM=10
CONFIG_ESP_WIFI_RX_BA_WIN=6
CONFIG_LWIP_MAX_SOCKETS=16
CONFIG_LWIP_TCP_SND_BUF_DEFAULT=16384
CONFIG_LWIP_TCP_WND_DEFAULT=16384
CONFIG_LWIP_TCP_OOSEQ_MAX_PBUFS=4

CONFIG_ESP_WIFI_SSID="Mau"
CONFIG_ESP_WIFI_PASSWORD="123456789d"
CONFIG_WIFI_PROVISIONING_SSID="TeleCafezinho"
CONFIG_WIFI_MODEM_SLEEP=y
CONFIG_WIFI_MULTI_NETWORK_CREDENTIALS=y
CONFIG_WIFI_STA_MAX_RETRY=3
CONFIG_WIFI_APSTA_POLICY=1
CONFIG_WIFI_APSTA_GRACE_PERIOD_S=600

CONFIG_BOOT_WIFI_CONFIG_BUTTON_GPIO=3
CONFIG_BOOT_WIFI_CONFIG_BUTTON_ACTIVE_LEVEL=1
CONFIG_BOOT_WIFI_CONFIG_BUTTON_SETTLE_MS=20
CONFIG_BOOT_WIFI_CONFIG_BUTTON_SAMPLE_COUNT=5
CONFIG_BOOT_WIFI_CONFIG_BUTTON_SAMPLE_INTERVAL_MS=10

CONFIG_WEB_PORTAL_ENABLE_LOGS_ENDPOINT=y
CONFIG_WEB_PORTAL_EXPOSE_NETWORK_IDENTIFIERS=y
CONFIG_WEB_PORTAL_DETAILED_HTTP_ERRORS=y
CONFIG_APP_LOG_BUFFER_CAPTURE_DEBUG=y

CONFIG_MQTT_PRESENCE_ENABLED=y
CONFIG_MQTT_BROKER_URI="mqtts://d77a33536b2143ba8d70a3abd3188ae5.s1.eu.hivemq.cloud:8883"
CONFIG_MQTT_USERNAME=""
CONFIG_MQTT_PASSWORD=""
CONFIG_MQTT_TOPIC_NAMESPACE="v1/telecafezinho"
CONFIG_MQTT_DEVICE_ID_PREFIX="TeleCafezinho"
CONFIG_MQTT_HEARTBEAT_INTERVAL_S=60
CONFIG_MQTT_KEEPALIVE_S=60
CONFIG_MQTT_QOS_CRITICAL=1
CONFIG_MQTT_QOS_TELEMETRY=0

CONFIG_TIME_SYNC_ENABLED=y
CONFIG_TIME_SYNC_TIMEZONE="<-03>3"
CONFIG_TIME_SYNC_MIN_VALID_YEAR=2024
CONFIG_TIME_SYNC_RETRY_ATTEMPTS=3
CONFIG_TIME_SYNC_WAIT_PER_ATTEMPT_MS=5000
CONFIG_TIME_SYNC_RETRY_DELAY_MS=60000
CONFIG_TIME_SYNC_IDLE_DELAY_MS=10000
CONFIG_TIME_SYNC_SERVER_0="pool.ntp.org"
CONFIG_TIME_SYNC_SERVER_1="time.google.com"
CONFIG_TIME_SYNC_SERVER_2="time.cloudflare.com"

CONFIG_POWER_GOOD_GPIO_ENABLED=y
CONFIG_POWER_GOOD_GPIO=6
CONFIG_POWER_GOOD_ACTIVE_LEVEL=1

CONFIG_ESP_MAIN_TASK_STACK_SIZE=6144
CONFIG_ESP_SYSTEM_EVENT_TASK_STACK_SIZE=4096
```
