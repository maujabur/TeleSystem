## components/status_led/Kconfig
```kconfig
menu "Status LED Config"

config STATUS_LED_ENABLED
    bool "Enable WS28xx status LED"
    default y

config STATUS_LED_GPIO
    int "Status LED GPIO"
    depends on STATUS_LED_ENABLED
    range 0 48
    default 48

config STATUS_LED_COUNT
    int "Status LED count"
    depends on STATUS_LED_ENABLED
    range 1 32
    default 1

config STATUS_LED_BRIGHTNESS
    int "Status LED brightness"
    depends on STATUS_LED_ENABLED
    range 0 255
    default 48
    help
        Global brightness scaler. 255 keeps the configured colors unchanged.

choice STATUS_LED_COLOR_ORDER
    prompt "Status LED color order"
    depends on STATUS_LED_ENABLED
    default STATUS_LED_COLOR_ORDER_GRB
    help
        Ordem fisica dos canais no LED WS28xx. As cores configuradas
        continuam em RGB no formato 0xRRGGBB; esta opcao define a ordem
        enviada no fio.

config STATUS_LED_COLOR_ORDER_RGB
    bool "RGB"

config STATUS_LED_COLOR_ORDER_RBG
    bool "RBG"

config STATUS_LED_COLOR_ORDER_GRB
    bool "GRB"

config STATUS_LED_COLOR_ORDER_GBR
    bool "GBR"

config STATUS_LED_COLOR_ORDER_BRG
    bool "BRG"

config STATUS_LED_COLOR_ORDER_BGR
    bool "BGR"

endchoice

config STATUS_LED_RMT_RESOLUTION_HZ
    int "Status LED RMT resolution (Hz)"
    depends on STATUS_LED_ENABLED
    range 1000000 40000000
    default 10000000

config STATUS_LED_TASK_STACK_SIZE
    int "Status LED task stack size"
    depends on STATUS_LED_ENABLED
    range 2048 8192
    default 3072

config STATUS_LED_TASK_PRIORITY
    int "Status LED task priority"
    depends on STATUS_LED_ENABLED
    range 1 10
    default 3

config STATUS_LED_BOOT_COLOR
    hex "Boot color RGB"
    depends on STATUS_LED_ENABLED
    default 0x202020

config STATUS_LED_WIFI_CONNECTING_COLOR
    hex "Wi-Fi connecting color RGB"
    depends on STATUS_LED_ENABLED
    default 0x0040FF

config STATUS_LED_WIFI_PROVISIONING_COLOR
    hex "Wi-Fi provisioning color RGB"
    depends on STATUS_LED_ENABLED
    default 0xFF9000

config STATUS_LED_WIFI_CONNECTED_COLOR
    hex "Wi-Fi connected color RGB"
    depends on STATUS_LED_ENABLED
    default 0x00B050

config STATUS_LED_ERROR_COLOR
    hex "Error color RGB"
    depends on STATUS_LED_ENABLED
    default 0xFF0000

config STATUS_LED_PRODUCT_TRANSMITTING_COLOR
    hex "Product transmitting color RGB"
    depends on STATUS_LED_ENABLED
    default 0x8000FF

config STATUS_LED_PRODUCT_WAITING_COLOR
    hex "Product waiting color RGB"
    depends on STATUS_LED_ENABLED
    default 0x00C8FF

config STATUS_LED_PRODUCT_RESULT_OK_COLOR
    hex "Product result OK color RGB"
    depends on STATUS_LED_ENABLED
    default 0x00FF00

config STATUS_LED_PRODUCT_RESULT_ALERT_COLOR
    hex "Product result alert color RGB"
    depends on STATUS_LED_ENABLED
    default 0xFF00A0

config STATUS_LED_OUTPUT_ACTIVE_COLOR
    hex "Output active color RGB"
    depends on STATUS_LED_ENABLED
    default 0xFFFFFF

config STATUS_LED_CAPTURE_OVERLAY_COLOR
    hex "Capture overlay pulse color RGB"
    depends on STATUS_LED_ENABLED
    default 0xFFFFFF

config STATUS_LED_BOOT_ON_MS
    int "Boot blink on time (ms)"
    depends on STATUS_LED_ENABLED
    range 10 60000
    default 100

config STATUS_LED_BOOT_OFF_MS
    int "Boot blink off time (ms)"
    depends on STATUS_LED_ENABLED
    range 10 60000
    default 900

config STATUS_LED_WIFI_CONNECTING_ON_MS
    int "Wi-Fi connecting blink on time (ms)"
    depends on STATUS_LED_ENABLED
    range 10 60000
    default 150

config STATUS_LED_WIFI_CONNECTING_OFF_MS
    int "Wi-Fi connecting blink off time (ms)"
    depends on STATUS_LED_ENABLED
    range 10 60000
    default 150

config STATUS_LED_WIFI_PROVISIONING_ON_MS
    int "Wi-Fi provisioning blink on time (ms)"
    depends on STATUS_LED_ENABLED
    range 10 60000
    default 700

config STATUS_LED_WIFI_PROVISIONING_OFF_MS
    int "Wi-Fi provisioning blink off time (ms)"
    depends on STATUS_LED_ENABLED
    range 10 60000
    default 700

config STATUS_LED_ERROR_ON_MS
    int "Error blink on time (ms)"
    depends on STATUS_LED_ENABLED
    range 10 60000
    default 100

config STATUS_LED_ERROR_OFF_MS
    int "Error blink off time (ms)"
    depends on STATUS_LED_ENABLED
    range 10 60000
    default 100

config STATUS_LED_PRODUCT_TRANSMITTING_ON_MS
    int "Product transmitting blink on time (ms)"
    depends on STATUS_LED_ENABLED
    range 10 60000
    default 120

config STATUS_LED_PRODUCT_TRANSMITTING_OFF_MS
    int "Product transmitting blink off time (ms)"
    depends on STATUS_LED_ENABLED
    range 10 60000
    default 120

config STATUS_LED_PRODUCT_WAITING_ON_MS
    int "Product waiting blink on time (ms)"
    depends on STATUS_LED_ENABLED
    range 10 60000
    default 250

config STATUS_LED_PRODUCT_WAITING_OFF_MS
    int "Product waiting blink off time (ms)"
    depends on STATUS_LED_ENABLED
    range 10 60000
    default 750

config STATUS_LED_CAPTURE_OVERLAY_ON_MS
    int "Capture overlay pulse on time (ms)"
    depends on STATUS_LED_ENABLED
    range 1 1000
    default 40

config STATUS_LED_CAPTURE_OVERLAY_OFF_MS
    int "Capture overlay pulse off time (ms)"
    depends on STATUS_LED_ENABLED
    range 1 60000
    default 760

config STATUS_LED_LOW_BATTERY_COLOR
    hex "Low battery color RGB"
    depends on STATUS_LED_ENABLED
    default 0xFF2000

config STATUS_LED_LOW_BATTERY_ON_MS
    int "Low battery blink on time (ms)"
    depends on STATUS_LED_ENABLED
    range 10 60000
    default 200

config STATUS_LED_LOW_BATTERY_OFF_MS
    int "Low battery blink off time (ms)"
    depends on STATUS_LED_ENABLED
    range 10 60000
    default 800

endmenu
```

## components/tele_ca_store/Kconfig
```kconfig
menu "Tele CA store"

    config TELE_CA_STORE_STORAGE_LABEL
        string "CA store SPIFFS partition label"
        default "ca_store"

    config TELE_CA_STORE_BASE_PATH
        string "CA store mount path"
        default "/ca_store"

    config TELE_CA_STORE_BUNDLE_FILENAME
        string "CA bundle filename"
        default "bundle_ca.bin"

    config TELE_CA_STORE_VERSION_FILENAME
        string "CA bundle version filename"
        default "bundle_ca.version"

    config TELE_CA_STORE_MAX_BUNDLE_SIZE
        int "Maximum CA bundle size"
        default 262144

endmenu
```

## components/tele_ca_updater/Kconfig
```kconfig
menu "Tele CA updater"

    config TELE_CA_UPDATER_BOOT_ENABLED
        bool "Check CA manifest after Wi-Fi connects"
        default n

    config TELE_CA_UPDATER_MANIFEST_URL
        string "CA bundle manifest URL"
        default ""

    config TELE_CA_UPDATER_CHANNEL
        string "CA bundle update channel"
        default "stable"

    config TELE_CA_UPDATER_RESTART_ON_UPDATE
        bool "Restart after applying a CA bundle update"
        default n

    config TELE_CA_UPDATER_BOOT_WAIT_TIMEOUT_MS
        int "Boot CA update Wi-Fi wait timeout in milliseconds"
        default 60000

    config TELE_CA_UPDATER_MAX_MANIFEST_SIZE
        int "Maximum CA manifest size"
        default 4096

    config TELE_CA_UPDATER_MAX_BUNDLE_SIZE
        int "Maximum CA bundle artifact size"
        default 262144

endmenu
```

## components/tele_manifest/Kconfig
```kconfig
menu "Tele manifest updater"

    config TELE_MANIFEST_HTTP_TIMEOUT_MS
        int "HTTP timeout in milliseconds"
        default 15000

    config TELE_MANIFEST_MAX_REDIRECTS
        int "Maximum HTTP redirects"
        default 5

    config TELE_MANIFEST_DOWNLOAD_BUFFER_SIZE
        int "HTTP artifact download buffer size"
        default 4096

    config TELE_MANIFEST_DEFAULT_MAX_MANIFEST_SIZE
        int "Default maximum manifest size"
        default 4096

endmenu
```

## components/tele_mqtt/Kconfig
```kconfig
menu "Tele MQTT Core Config"

config TELE_MQTT_MAX_SHARED_SUBSCRIPTIONS
    int "Maximum shared MQTT subscriptions"
    range 1 16
    default 8
    help
        Limite de inscricoes compartilhadas registradas por componentes de
        dominio via tele_mqtt_subscribe_shared().

config TELE_MQTT_SHARED_TOPIC_SUFFIX_MAX_LEN
    int "Maximum shared MQTT topic suffix length"
    range 8 96
    default 64
    help
        Tamanho maximo do sufixo relativo usado em
        {base_topic}/_shared/{topic_suffix}.

endmenu
```

## components/tele_portal/Kconfig
```kconfig
menu "Web Portal Config"

config WEB_PORTAL_EXPOSE_NETWORK_IDENTIFIERS
    bool "Expose SSID/IP identifiers in technical APIs"
    default n
    help
        Quando desativado, /api/status e APIs tecnicas relacionadas evitam
        expor SSID/IP/provisioning_ssid diretamente.

config WEB_PORTAL_DETAILED_HTTP_ERRORS
    bool "Return detailed internal errors in HTTP responses"
    default n
    help
        Quando desativado, endpoints tecnicos retornam mensagens genericas
        para falhas internas, reduzindo exposicao de detalhes internos.

endmenu
```

## components/tele_portal_logs/Kconfig
```kconfig
menu "Tele Portal Logs"

config TELE_PORTAL_LOGS_ENABLE_ENDPOINT
    bool "Enable /api/logs endpoint"
    default y
    help
        Mantem a API de logs disponivel no portal tecnico. Recomendado
        desativado para builds de release.

config TELE_PORTAL_LOGS_CAPTURE_DEBUG
    bool "Capture DEBUG/VERBOSE logs in portal logs buffer"
    default n
    help
        Quando desativado, o buffer usado por /api/logs ignora linhas de
        DEBUG/VERBOSE para reduzir ruido e volume.

endmenu
```

## components/tele_presence/Kconfig
```kconfig
menu "MQTT Presence Config"

config MQTT_PRESENCE_ENABLED
    bool "Enable MQTT presence and heartbeat"
    default n
    help
        Habilita publicacao de presenca online/offline, heartbeat e canal
        basico de comando MQTT para operacao remota.

config MQTT_BROKER_URI
    string "MQTT broker URI"
    depends on MQTT_PRESENCE_ENABLED
    default ""
    help
        URI do broker MQTT, por exemplo: mqtts://broker.exemplo.com:8883

config MQTT_USERNAME
    string "MQTT username"
    depends on MQTT_PRESENCE_ENABLED
    default ""

config MQTT_PASSWORD
    string "MQTT password"
    depends on MQTT_PRESENCE_ENABLED
    default ""

config MQTT_TOPIC_NAMESPACE
    string "MQTT topic namespace"
    depends on MQTT_PRESENCE_ENABLED
    default "v1/led"
    help
        Prefixo de topicos usado pelo dispositivo. O device_id sera
        anexado automaticamente.

config MQTT_DEVICE_ID_PREFIX
    string "MQTT device ID prefix"
    depends on MQTT_PRESENCE_ENABLED
    default "TeleCafezinho"
    help
        Prefixo usado para montar o device_id publicado em MQTT.

config MQTT_HEARTBEAT_INTERVAL_S
    int "Heartbeat interval (seconds)"
    depends on MQTT_PRESENCE_ENABLED
    range 15 3600
    default 60

config MQTT_KEEPALIVE_S
    int "MQTT keepalive (seconds)"
    depends on MQTT_PRESENCE_ENABLED
    range 15 1200
    default 60

config MQTT_QOS_CRITICAL
    int "QoS for status/state/command"
    depends on MQTT_PRESENCE_ENABLED
    range 0 2
    default 1

config MQTT_QOS_TELEMETRY
    int "QoS for heartbeat/telemetry"
    depends on MQTT_PRESENCE_ENABLED
    range 0 2
    default 0

endmenu
```

## components/tele_system/Kconfig
```kconfig
menu "VBAT Monitor Config"

config VBAT_MONITOR_ENABLED
    bool "Enable VBAT monitor"
    default n
    help
        Habilita monitoramento de tensao da bateria por ADC com calibracao.

config VBAT_MONITOR_GPIO
    int "VBAT ADC GPIO"
    depends on VBAT_MONITOR_ENABLED
    range 0 48
    default 1
    help
        GPIO conectada ao divisor resistivo da bateria.

config VBAT_MONITOR_MAX_INTERVAL_S
    int "Max interval without VBAT measurement (seconds)"
    depends on VBAT_MONITOR_ENABLED
    range 0 86400
    default 120
    help
        Tempo maximo sem tentativa de medicao. Use 0 para desabilitar.

config VBAT_MONITOR_ON_BOOT
    bool "Measure at startup"
    depends on VBAT_MONITOR_ENABLED
    default y

config VBAT_MONITOR_ON_BEFORE_WIFI_PS_EXIT
    bool "Measure before leaving Wi-Fi power save"
    depends on VBAT_MONITOR_ENABLED
    default y

config VBAT_MONITOR_ON_AFTER_PRODUCT_TX
    bool "Measure after product transmission"
    depends on VBAT_MONITOR_ENABLED
    default y

config VBAT_MONITOR_ON_AFTER_PRODUCT_ACTIVITY
    bool "Measure after product activity"
    depends on VBAT_MONITOR_ENABLED
    default y

config VBAT_MONITOR_ON_MAX_INTERVAL
    bool "Measure when max interval elapses"
    depends on VBAT_MONITOR_ENABLED
    default y

config VBAT_SHUTDOWN_ENABLED
    bool "Enable low-battery shutdown"
    depends on VBAT_MONITOR_ENABLED
    default y
    help
        Quando habilitado, o sistema desliga os perifericos via POWER_GOOD
        e entra em deep sleep (sem wakeup por timer) ao detectar tensao
        critica por tempo suficiente.

config VBAT_SHUTDOWN_THRESHOLD_MV
    int "Low-battery shutdown threshold (mV)"
    depends on VBAT_SHUTDOWN_ENABLED
    range 2500 4200
    default 3500
    help
        Tensao da bateria abaixo da qual o desligamento e iniciado.
        Recomendado: 3500 mV para Li-Ion/LiPo de celula unica.

config VBAT_SHUTDOWN_DEBOUNCE_MS
    int "Low-battery shutdown debounce time (ms)"
    depends on VBAT_SHUTDOWN_ENABLED
    range 100 10000
    default 1000
    help
        Tempo minimo continuo com tensao abaixo do limiar para confirmar
        desligamento. Evita falsos positivos por quedas de tensao sob carga.

config VBAT_MAINTENANCE_MODE_MAX_MV
    int "Maintenance mode detection threshold (mV)"
    depends on VBAT_SHUTDOWN_ENABLED
    range 0 2000
    default 500
    help
        Se a tensao lida for menor ou igual a este valor, o sistema assume
        modo de manutencao (bateria desconectada) e inibe o desligamento
        automatico por bateria baixa.

config VBAT_MONITOR_RDIV_RVCC
    int "Voltage divider resistor Rvcc (ohms)"
    depends on VBAT_MONITOR_ENABLED
    range 1 1000000
    default 4640
    help
        Resistor entre VCC da bateria e o pino ADC no divisor de tensao.

config VBAT_MONITOR_RDIV_RGND
    int "Voltage divider resistor Rgnd (ohms)"
    depends on VBAT_MONITOR_ENABLED
    range 1 1000000
    default 5620
    help
        Resistor entre o pino ADC e GND no divisor de tensao.

endmenu

menu "POWER_GOOD GPIO Config"

config POWER_GOOD_GPIO_ENABLED
    bool "Enable POWER_GOOD output GPIO"
    default y
    help
        Habilita o sinal POWER_GOOD: GPIO de saida que alimenta perifericos
        externos via MOSFET. Seta alto ao inicializar
        e baixo antes de entrar em deep sleep.

config POWER_GOOD_GPIO
    int "POWER_GOOD GPIO number"
    depends on POWER_GOOD_GPIO_ENABLED
    range 0 48
    default 6
    help
        Numero da GPIO usada como sinal POWER_GOOD.

config POWER_GOOD_ACTIVE_LEVEL
    int "POWER_GOOD active level (1=high, 0=low)"
    depends on POWER_GOOD_GPIO_ENABLED
    range 0 1
    default 1
    help
        Nivel logico que representa "perifericos ligados".
        Use 1 para MOSFET ativo em nivel alto.

endmenu
```
